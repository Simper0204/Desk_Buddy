#include <Wire.h>
#include <Adafruit_GFX.h>
#include <Adafruit_SSD1306.h>

#define SCREEN_WIDTH 128 
#define SCREEN_HEIGHT 64 

#define FRAME_DELAY (42)
#define FRAME_WIDTH (48)
#define FRAME_HEIGHT (48)
#define FRAME_COUNT1 (sizeof(frames1) / sizeof(frames1[0]))
#define FRAME_COUNT2 (sizeof(frames2) / sizeof(frames2[0]))
#define FRAME_COUNT3 (sizeof(frames3) / sizeof(frames3[0]))

//mã tạo mặt cười
const byte PROGMEM frames1[][288] = {
  {0,0,0,0,0,0,0,0,0,0,0,0,0,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0,0}
};

//mã tạo mặt bình thường
const byte PROGMEM frames2[][288] = {
  {0,0,0,0,0,0,0,0,0,0,0,0,0,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0,0}

};

//mã tạo mặt ngủ
const byte PROGMEM frames3[][288] = {
  {0,0,0,0,0,0,0,0,0,0,0,0,0,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0,0},
  {0,0,0,0,0,0,0,0,0,0,0,0,0,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0,0},
  {0,0,0,0,0,0,0,0,0,0,0,0,0,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0,0},
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  {0,0,0,0,0,0,0,0,0,0,0,0,0,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0,0}
};

Adafruit_SSD1306 display(SCREEN_WIDTH, SCREEN_HEIGHT, &Wire, -1);

//Đặt các biến sẽ sử dụng
int frame = 0;          
const int OLED_SCL = A5;
const int OLED_SDA = A4;
const int LDR_D0 = 2;
const int BUZZ_A = 6; 
const int BUTTON = 3;

bool buttonState = false;

bool wakeUpSoundPlayed = false;
bool sleepSoundPlayed = false;
bool angrySoundPlayed = false;
bool playAngrySound = false;

bool awake = true;
bool sleep = false;
bool angry = false;

//Thay đổi các bài hát
const int wakeUpSong[] = {261, 329, 392}; //Bài hát khi tỉnh giấc
const int sleepSong[] = {392, 349, 329, 293, 261}; //Bài hát khi đi ngủ
const int angrySong[] = {523, 494, 440, 392, 349}; //Bài hát khi tức giận
const int randomSong[] = {261, 261, 261, 261, 261}; //Bài hát ngẫu nhiên
int currentButtonReading = HIGH;
int lastButtonReading = HIGH;

unsigned long lastDebounceTime = 0;
unsigned long lastPressTime = 0;

unsigned long angryStartTime = 0;
const unsigned long angryDuration = 5000;

const unsigned long debounceDelay = 30;
const unsigned long pressTimeout = 2000;
int numberOfPress = 0;

unsigned long nextRandomSongTime = 0;

bool randomSongPlayed = false;


void setup() {
  display.begin(SSD1306_SWITCHCAPVCC, 0x3C);
  display.clearDisplay();
  display.setTextSize(2);
  display.setTextColor(WHITE);
  display.setCursor(0, 0);

  pinMode(LDR_D0, INPUT);
  pinMode(BUTTON, INPUT_PULLUP);
  pinMode(BUZZ_A, OUTPUT);
  
  randomSeed(analogRead(A0));
  nextRandomSongTime = millis() + random(5000, 20001);
}

void loop() {
  unsigned long currentTime = millis();

  //Cảm biến ánh sáng thay đổi trạng thái của robot

  if(digitalRead(LDR_D0) == 0){
  awake = true;
  sleep = false;
  } else if(digitalRead(LDR_D0) == 1){
  awake = false;
  sleep = true;
  }

  //Trạng thái tỉnh giấc

  if(awake == true){ 
    sleepSoundPlayed = false;
    if (!wakeUpSoundPlayed) {
      playWakeUpSound();
      wakeUpSoundPlayed = true;
    }

    //Tương tác bấm nút
    int reading = digitalRead(BUTTON);

    if(reading != lastButtonReading)
      lastDebounceTime = currentTime;
    if(currentTime - lastDebounceTime >= debounceDelay){ //debounce logic
      if(reading != buttonState){ //update buttonState
        buttonState = reading;
        if(buttonState == LOW){ //if is pressed
          currentTime = millis();
          pressedRoutine();
          if (numberOfPress > 0 && currentTime - lastPressTime > pressTimeout){ //check while button is still low
            numberOfPress = 0;
          }

          numberOfPress++;
          lastPressTime = currentTime;

          if(angry){
            angryStartTime = millis();
            playAngrySound = false;
          }

          if(numberOfPress > 3){ //change to angry after 3 presses
            angry = true;
            angryStartTime = millis(); 
            numberOfPress = 0;
            angrySoundPlayed = false;
          }
        }
      }
    }

    lastButtonReading = reading;
    currentTime = millis();
    if (numberOfPress > 0 && currentTime - lastPressTime > pressTimeout) { //check while button is high
      numberOfPress = 0;
      angry = false;
      angrySoundPlayed = false;
      noTone(BUZZ_A);
    }

    if(angry && millis() - angryStartTime >= angryDuration){
      angry = false;
      angrySoundPlayed = false;
      playAngrySound = false;
    }

    //Trạng thái tức giận
    if(angry)
      angryRoutine();
    else
      awakeRoutine();

    if (!angry && millis() >= nextRandomSongTime) {
      playRandomSound();
      nextRandomSongTime = millis() + random(5000, 10001);
    }
  }
  
  //Trại thái đi ngủ
  if(sleep == true) {
  sleepRoutine();
    if(!sleepSoundPlayed){
      playSleepSound();
      sleepSoundPlayed = true;
    }
  }
}

//Đặt các hàm sẽ sử dụng
void playWakeUpSound(){
  for(int i = 0; i < 3; i++){
    tone(BUZZ_A, wakeUpSong[i]);
    delay(500);
  }
  noTone(BUZZ_A);
}

void playAngrySoundAction(){
  for(int i = 0; i < 3; i++){
    tone(BUZZ_A, angrySong[i]);
    delay(500);
  }
  noTone(BUZZ_A);
}

void playSleepSound(){
  for(int i = 0; i < 5; i++){
    tone(BUZZ_A, sleepSong[i]);
    delay(500);
  }
  noTone(BUZZ_A);
}

void playRandomSound(){
  for (int i = 0; i < 5; i++) {
    tone(BUZZ_A, randomSong[i]);
    delay(500);
  }
  noTone(BUZZ_A);
}

void sleepRoutine(){
  wakeUpSoundPlayed = false;
  nextRandomSongTime = millis() + random(5000, 10001);
  for (int frame = 0; frame < FRAME_COUNT3; frame++) { //Sleep face display
    display.clearDisplay();
    display.drawBitmap(
      40, 8,
      frames3[frame],
      FRAME_WIDTH,
      FRAME_HEIGHT,
      WHITE
    );
    display.display();
    delay(FRAME_DELAY);
  }
}

void pressedRoutine(){
  display.clearDisplay();
  display.setTextSize(2);
  display.setTextColor(WHITE);
  display.setCursor(0, 0);
  display.print(">.< hihi");
  display.display();
  tone(BUZZ_A, 440);
  delay(100);
  noTone(BUZZ_A);
  tone(BUZZ_A, 440);
  delay(100);
  noTone(BUZZ_A);
}

void angryRoutine(){
  display.clearDisplay();
  display.setTextSize(2);
  display.setTextColor(WHITE);
  display.setCursor(0, 0);
  display.print(F(">.< STOP!"));
  display.display();
  if (!angrySoundPlayed || playAngrySound) { //Play angry song
    playAngrySound = false;
    playAngrySoundAction();
    angrySoundPlayed = true;
  }
}

void awakeRoutine(){
  display.clearDisplay();
  display.drawBitmap(
    40, 8,
    frames1[frame],
    FRAME_WIDTH,
    FRAME_HEIGHT,
    WHITE
  );
  display.display();
  delay(FRAME_DELAY);
}

